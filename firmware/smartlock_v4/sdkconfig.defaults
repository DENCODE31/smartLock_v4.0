## firmware/smartlock_v4/sdkconfig.defaults
```kconfig
# NimBLE (BLE only) — required for ESP RainMaker BLE provisioning
CONFIG_BT_NIMBLE_ENABLED=y
# CONFIG_BT_BLUEDROID_ENABLED is not set
CONFIG_BT_NIMBLE_MSYS_1_BLOCK_COUNT=128
CONFIG_BT_NIMBLE_MSYS_1_BLOCK_SIZE=512
CONFIG_BT_NIMBLE_MSYS_2_BLOCK_SIZE=512
CONFIG_BT_NIMBLE_TRANSPORT_ACL_FROM_LL_COUNT=32

CONFIG_APP_NETWORK_PROV_TRANSPORT_BLE=y
CONFIG_APP_NETWORK_PROV_NAME_PREFIX="SmartLock"
CONFIG_APP_NETWORK_PROV_SHOW_QR=y
CONFIG_APP_NETWORK_PROV_TIMEOUT_PERIOD=15
CONFIG_APP_NETWORK_PROV_MAX_POP_MISMATCH=5

# 8MB flash (Heltec V3)
CONFIG_ESPTOOLPY_FLASHSIZE_8MB=y

# Custom partition table (OTA, factory NVS, spiffs)
CONFIG_PARTITION_TABLE_CUSTOM=y
CONFIG_PARTITION_TABLE_CUSTOM_FILENAME="partitions.csv"

# Disable challenge response (incompatible with self claiming)
# CONFIG_ESP_RMAKER_ENABLE_CHALLENGE_RESPONSE is not set

# Increase FreeRTOS timer task stack to prevent Tmr Svc overflow during OTA polling
CONFIG_FREERTOS_TIMER_TASK_STACK_DEPTH=4096
```
